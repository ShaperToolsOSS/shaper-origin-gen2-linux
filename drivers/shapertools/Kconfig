## drivers/shapertools/Kconfig
```kconfig
menu "Shaper Tools Drivers"

config MCU_SPI
	tristate "Base SPI Driver for STM32F411VE MCU"
	select SPI_IMX_SHAPER
	depends on ARCH_MXC && !SPI_IMX
	help
	  Say Y here if you want to enable Shaper Tools MCU SPI
	  driver with support for STM32F4 firmware flashing

config SPI_IMX_SHAPER
	tristate "Shaper Tools patched IMX SPI Driver"
	depends on ARCH_MXC && !SPI_IMX
	help
	  Say Y here if you want to enable Shaper Tool patched
	  SPI master driver

config REMOTEPROC_SHAPER
	tristate "Shaper IMX8MM remoteproc support"
	depends on ARCH_MXC && !IMX_REMOTEPROC
	help
	  Say y here to support iMX's remote processors (Cortex M4
	  on iMX8MM) via the remote processor framework.

config SHAPER_MCU_TTY
	tristate "Shaper Tool RPMSG TTY Driver"
	depends on HAVE_IMX_RPMSG
	help
	  Say Y here if you want to enable Shaper Tool RPMSG TTY
	  implementation

config SHAPER_MCU_LOG
	tristate "Shaper Tool RPMSG MCU Log Driver"
	depends on HAVE_IMX_RPMSG
	help
	  Say Y here if you want to enable Shaper Tool MCU RPMSG Log Driver

config SHAPER_MCU_CAPTURE
	tristate "Shaper Tool RPMSG MCU Capture Driver"
	depends on HAVE_IMX_RPMSG
	help
	  Say Y here if you want to enable Shaper Tool MCU RPMSG Capture Driver

config SHAPER_MCU_SPACES
	tristate "Shaper Tool MCU Spaces Driver"
	depends on IMX_MBOX
	help
	  Say Y here if you want to enable Shaper Tool MCU Spaces Driver

endmenu
```

## scripts/fitimage/net-boot-legacy.its
```
/dts-v1/;

/ {
	description = "Boot FitImage";
	#address-cells = <1>;

	images {
		boot-script {
			description = "Boot image script";
			data = /incbin/("net-boot-legacy.ubs");
			type = "script";
			compression = "none";
			hash@1 {
				algo = "md5";
			};
		};
		kernel {
			description = "Linux kernel";
			data = /incbin/("linux.bin");
			type = "kernel";
			arch = "arm64";
			os = "linux";
			compression = "none";
			load = <0x40480000>;
			entry = <0x40480000>;
			hash@1 {
				algo = "md5";
			};
		};
		fdt {
			description = "Flattened Device Tree blob";
			data = /incbin/("linux.dtb");
			type = "flat_dt";
			arch = "arm64";
			compression = "none";
			load = <0x43000000>;
			hash@1 {
				algo = "md5";
			};
		};
	};

	configurations {
		default = "boot-conf";
		boot-conf {
			description = "Boot Linux kernel with FDT blob";
			kernel = "kernel";
			fdt = "fdt";
			hash@1 {
				algo = "md5";
			};
		};
	};
};
```

## scripts/fitimage/net-boot-mcu.its
```
/dts-v1/;

/ {
	description = "Boot FitImage";
	#address-cells = <1>;

	images {
		boot-script {
			description = "Boot image script";
			data = /incbin/("net-boot-mcu.ubs");
			type = "script";
			compression = "none";
			hash@1 {
				algo = "sha256";
			};
		};
		mcu-firmware {
			description = "MCU firmware image";
			data = /incbin/("mcu-firmware.elf");
			type = "firmware";
			load = <0x4f1e0000>;
			compression = "zstd";
			hash@1 {
				algo = "sha256";
			};
		};
		kernel {
			description = "Linux kernel";
			data = /incbin/("linux.bin");
			type = "kernel";
			arch = "arm64";
			os = "linux";
			compression = "zstd";
			load = <0x40480000>;
			entry = <0x40480000>;
			hash@1 {
				algo = "sha256";
			};
		};
		fdt {
			description = "Flattened Device Tree blob";
			data = /incbin/("linux.dtb");
			type = "flat_dt";
			arch = "arm64";
			compression = "zstd";
			load = <0x43000000>;
			hash@1 {
				algo = "sha256";
			};
		};
	};

	configurations {
		default = "boot-conf";
		boot-conf {
			description = "Boot Linux kernel with FDT blob";
			kernel = "kernel";
			fdt = "fdt";
			hash@1 {
				algo = "sha256";
			};
		};
	};
};
```

## scripts/fitimage/primary-boot.its
```
/dts-v1/;

/ {
	description = "Boot scripts";
	#address-cells = <1>;

	images {
		boot-script {
		    description = "Primary boot stage";
		    data = /incbin/("primary-boot.ubs");
		    type = "script";
		    compression = "none";
   			hash@1 {
				algo = "sha256";
			};
		};
	};

};
```

## scripts/fitimage/sdcard-boot.its
```
/dts-v1/;

/ {
	description = "Boot FitImage";
	#address-cells = <1>;

	images {
		boot-script {
			description = "Boot image script";
			data = /incbin/("sdcard-boot.ubs");
			type = "script";
			compression = "none";
			hash@1 {
				algo = "sha256";
			};
		};
		kernel {
			description = "Linux kernel";
			data = /incbin/("linux.bin");
			type = "kernel";
			arch = "arm64";
			os = "linux";
			compression = "zstd";
			load = <0x40480000>;
			entry = <0x40480000>;
			hash@1 {
				algo = "sha256";
			};
		};
		fdt {
			description = "Flattened Device Tree blob";
			data = /incbin/("linux.dtb");
			type = "flat_dt";
			arch = "arm64";
			compression = "zstd";
			load = <0x43000000>;
			hash@1 {
				algo = "sha256";
			};
		};
	};

	configurations {
		default = "boot-conf";
		boot-conf {
			description = "Boot Linux kernel with FDT blob";
			kernel = "kernel";
			fdt = "fdt";
			hash@1 {
				algo = "sha256";
			};
		};
	};
};
```
